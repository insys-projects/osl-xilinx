
/ {
    zdev_instance: zdev@b0000000 {
        status = "okay";
        compatible = "insys,lzynq";
        #address-cells = <0x1>;
        #size-cells = <0x1>;
        reg = <0 0xb0000000 0 0x80000 0 0xb0080000 0 0x80000>;
        interrupt-parent = <&gic>;
        interrupt-names = "ZDMA0", "ZDMA1", "ZTRD";
        interrupts = <0 92 4>, <0 93 4>, <0 94 4>; 
    };
};
