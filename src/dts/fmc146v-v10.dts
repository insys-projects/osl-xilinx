/dts-v1/;

#include "fmc146v.dtsi"
#include "zynq-zdev.dtsi"

/ {
        model = "fmc146v";
        compatble = "insys,fmc146v", "xlnx,zynq-7000";

        aliases {
                ethernet0 = &gem0;
                ethernet1 = &gem1;
                i2c0 = &i2c0;
                i2c1 = &i2c1;
                serial0 = &uart0;
                serial1 = &mdm_0;
                spi0 = &qspi;
        };
        memory {
                device_type = "memory";
                reg = <0x0 0x40000000>;
        };
        cpus {
                /delete-node/ cpu@1 ;
        };

};
