/dts-v1/;

#include "zynqmp.dtsi"
#include "zynqmp-clk-ccf.dtsi"

/ {
    aliases {
        i2c0 = &i2c0;
        i2c1 = &i2c1;
        serial0 = &uart0;
        serial1 = &uart1;
        spi0 = &qspi;
    };
};