## src/kernel/arm/fit-kernel.its
```
/dts-v1/;

/ {
	description = "FIT image kernel";
	#address-cells = <1>;

	images {
		kernel-1 {
			description = "Linux Kernel";
			data = /incbin/("zImage");
			type = "kernel";
			arch = "arm";
			os = "linux";
			compression = "none";
			load = <0x8000>;
			entry = <0x8000>;
			hash-1 {
				algo = "sha1";
			};
		};
	};
	configurations {
		default = "conf-1";
		conf-1 {
			description = "Linux kernel without FDT";
			kernel = "kernel-1";
			hash-1 {
				algo = "sha1";
			};
		};
	};
};
```

## src/kernel/arm64/fit-kernel-full.its
```
/dts-v1/;

/ {
	description = "FIT image kernel";
	#address-cells = <1>;

	images {
		kernel-1 {
			description = "Linux Kernel";
			data = /incbin/("Image.gz");
			type = "kernel";
			arch = "arm64";
			os = "linux";
			compression = "gzip";
			load = <0x8000>;
			entry = <0x8000>;
			hash-1 {
				algo = "sha1";
			};
		};
		fdt-1 {
			description = "Flattened Device Tree";
			data = /incbin/("system.dtb");
			type = "flat_dt";
			arch = "arm64";
			compression = "none";
			hash-1 {
				algo = "sha1";
			};
		};
		ramdisk-1 {
			description = "ramdisk";
			data = /incbin/("ramdisk.gz");
			type = "ramdisk";
			arch = "arm64";
			os = "linux";
			compression = "none";
			hash-1 {
				algo = "sha1";
			};
		};
	};
	configurations {
		default = "conf-3";
		conf-1 {
			description = "Linux kernel without FDT";
			kernel = "kernel-1";
			hash-1 {
				algo = "sha1";
			};
		};
		conf-2 {
			description = "Linux kernel with FDT";
			kernel = "kernel-1";
			fdt = "fdt-1";
			hash-1 {
				algo = "sha1";
			};
		};
		conf-3 {
			description = "Linux kernel with FDT and RAMDISK";
			kernel = "kernel-1";
			fdt = "fdt-1";
			ramdisk = "ramdisk-1";
			hash-1 {
				algo = "sha1";
			};
		};
	};
};
```

## src/kernel/arm64/fit-kernel.its
```
/dts-v1/;

/ {
	description = "FIT image kernel";
	#address-cells = <1>;

	images {
		kernel-1 {
			description = "Linux Kernel";
			data = /incbin/("Image.gz");
			type = "kernel";
			arch = "arm64";
			os = "linux";
			compression = "gzip";
			load = <0x8000>;
			entry = <0x8000>;
			hash-1 {
				algo = "sha1";
			};
		};
	};
	configurations {
		default = "conf-1";
		conf-1 {
			description = "Linux kernel without FDT";
			kernel = "kernel-1";
			hash-1 {
				algo = "sha1";
			};
		};
	};
};
```
